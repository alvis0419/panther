## linux-4.4.14/arch/mips/panther/Kconfig
```kconfig
config PANTHER_FPGA
	bool "Panther FPGA platform"
	depends on PANTHER
	default n

config MTD_PANTHER
	tristate "Flash device mapped on Panther"
	depends on PANTHER
	select MTD
	select MTD_COMPLEX_MAPPINGS
	select MTD_ROM
	select MTD_PARTITIONS
	default y
	help
	  This enables access routines for the flash chips on the Panther board

#config SF_RX_DIV
#	int "the clock factor for flash SPI Rx commands"
#	range 2 15
#	depends on MTD_PANTHER
#	default 3

#config SF_TX_DIV
#	int "the clock factor for flash SPI Tx commands"
#	range 0 15
#	depends on MTD_PANTHER
#	default 3

config PANTHER_MTD_SIZE
	hex "Flash size"
	depends on MTD_PANTHER
	default 0x800000

config PANTHER_KERNEL_SIZE
	hex "Kernel partitions size"
	depends on MTD_PANTHER
	default 2

#config PANTHER_BACKUP_IMAGE
#	bool "Consider Backup Partition"
#	depends on MTD_PANTHER
#	default n
#	help
#	  Say Y here to support flash with backup image.
#config PANTHER_BACKUP_SIZE
#	hex "The Paritiion Size for Backup Image"
#	range 0 PANTHER_MTD_SIZE
#	depends on PANTHER_BACKUP_IMAGE
#	default 0x300000
#config PANTHER_BACKUP_IMAGE_BUILD
#	bool "Build Backup Image"
#	depends on PANTHER_BACKUP_IMAGE
#	default n
#	help
#	  Say Y here to build a backup image.

config PANTHER_MTD_SE
	bool "Sector erase"
	depends on MTD_PANTHER
	default y

config DYNAMIC_PARTITION_ROOTFS
	bool "dynamic partition for rootfs"
	depends on MTD_PANTHER
	default y

choice
	prompt "read&write paritiion"
	depends on MTD_PANTHER
	default MTD_ROOTFS_SPLIT
config MTD_RWPART_NONE
	bool "None"
config MTD_ROOTFS_SPLIT
	bool "split from rootfs partition(squashfs)"
config MTD_RWPART_EXTRA_PARTITION
	bool "extra partition"
endchoice

#config MTD_RWPART_EXTRA_PARTITION_OFFSET
#	hex "the offset of extra partition"
#	depends on MTD_RWPART_EXTRA_PARTITION
#	default 0x400000

config PANTHER_ANA_KEYPAD
	bool "Panther ana Keypad"
	depends on PANTHER
	default n
	help
		This enable panther ana keypad.

config PANTHER_KEYPAD		 
	bool "Panther Keypad"		 
	depends on PANTHER
	select PANTHER_MADC			 
	default n		 
	help		 
		This enable panther keypad.

config PANTHER_LCD
	bool "Panther lcd"
	depends on PANTHER
	default n
	help
		This enable panther lcd.
choice
	depends on PANTHER_LCD
	prompt "Panther type"
	default PANTHER_ST7565P_LCD
config PANTHER_ST7565P_LCD
	bool "st7565p"
config PANTHER_ST7588T_LCD
	bool "st7588t"
endchoice

config PANTHER_ST7565P_LCD_GPIO_CS1
	int "GPIO Number for st7565p CS1 pin"
	range 0 29
	depends on PANTHER_ST7565P_LCD
	default 20
config PANTHER_ST7565P_LCD_GPIO_A0
	int "GPIO Number for st7565p A0 pin"
	range 0 29
	depends on PANTHER_ST7565P_LCD
	default 22
config PANTHER_ST7565P_LCD_GPIO_SDI
	int "GPIO Number for st7565p SDI pin"
	range 0 29
	depends on PANTHER_ST7565P_LCD
	default 21
config PANTHER_ST7565P_LCD_GPIO_SCL
	int "GPIO Number for st7565p SCL pin"
	range 0 29
	depends on PANTHER_ST7565P_LCD
	default 23

config PANTHER_ST7588T_LCD_GPIO_SDA
	int "GPIO Number for st7588t SDA pin"
	range 0 29
	depends on PANTHER_ST7588T_LCD
	default 22
config PANTHER_ST7588T_LCD_GPIO_SCL
	int "GPIO Number for st7588t SCL pin"
	range 0 29
	depends on PANTHER_ST7588T_LCD
	default 23

config PANTHER_MADC
	bool "Panther madc"
	depends on PANTHER
	default n
	help
		This enable panther madc.
 
config PANTHER_PWM
	bool "Panther pwm"
	depends on PANTHER
	default n
	help
		This enable panther pwm.

config PANTHER_4M_JFFS2
	bool "To reserve 4M jffs2"
	depends on PANTHER
	default n
	help
		This enable to reserve 4M jffs2. 


choice
	prompt "Select Sniffer Mode "
	default PANTHER_SMART_CONFIG

config PANTHER_SMART_CONFIG
	bool "Panther Smart Config"
	depends on PANTHER
	help
		This enable panther smart config. 

config PANTHER_SMART_TO_USRSPACE
    bool "Sniffer to User Space"
    depends on PANTHER

endchoice

config PANTHER_WLAN
	bool "Dragonite WLAN driver"
	default n

config PANTHER_ETH
	bool "Panther Ethernet"
	depends on PANTHER
	select VLAN_8021Q

config PANTHER_SKB_RECYCLE_2K
	bool "SKB Recycling"
	depends on PANTHER_ETH
	default n

config P0_AS_LAN
	bool "Switch P0 as LAN"
	depends on PANTHER_ETH
	default n

config P0_AS_ADDR2
	bool "Switch P0 as addr 2"
	depends on PANTHER_ETH
	default n

config P0_EXT_PHY
	bool "Switch P0 as External PHY"
	depends on PANTHER_ETH
	select P0_RMII
	select P0_RMII_CLKOUT
	default n

config P0_RMII
	depends on P0_EXT_PHY
	bool
	default n

config P0_RMII_CLKOUT
	depends on P0_EXT_PHY
	bool
	default n

config P1_EXT_PHY
	bool "Switch P1 as External PHY"
	depends on PANTHER_ETH
	default n

config P1_RMII
	depends on PANTHER_ETH
	bool
	default y

config P1_RMII_CLKOUT
	depends on PANTHER_ETH
	bool
	default y

config EPHY_GLITCH_PATCH
	bool "EPHY glitch patch"
	depends on PANTHER_ETH && PANTHER_USB
	default n

config HNAT_PATCH
	bool "HW-NAT patch"
	depends on PANTHER_ETH
	default y

config SRAM_ENABLE
	bool "SRAM Enable"
	depends on PANTHER

config PANTHER_INTERNAL_DEBUGGER
	bool "Panther internal debugger"
	depends on PANTHER
	default y

config PANTHER_ENABLE_DEBUGFS
	bool "Panther debug via debugfs"
	depends on PANTHER
	select DEBUG_FS
	default n

config PANTHER_SND
	tristate "Panther Sound driver"
	depends on PANTHER
	select SOUND
	select SND
	select SND_PCM_OSS
	select SND_SOC
	select NET
	select COMPAT_WIRELESS
	select COMPAT_PATCH
	default n

config PANTHER_SND_DEDICATED_I2C
	bool "Dedicated I2C Pins For Codec"
	depends on PANTHER_SND
	default y
config PANTHER_SND_SCL_GPIO_NUM
	int "GPIO Number for I2C Clock (0~29)"
	range 0 29
	depends on PANTHER_SND_DEDICATED_I2C
	default 10
config PANTHER_SND_SDA_GPIO_NUM
	int "GPIO Number for I2C Data (0~29)"
	range 0 29
	depends on PANTHER_SND_DEDICATED_I2C
	default 11

config PCMGPIOCONTROL
	bool "PCMGPIOCONTROL"
	depends on PANTHER_SND
	default n

config GPIO_AUDIO_AMP_POWER
	bool "Use GPIO to Control Audio AMP Power"
	depends on PANTHER_SND
	default n

config GPIO_AUDIO_AMP_POWER_NUM
	int "GPIO Number to Control Audio AMP Power (0~29)"
	range 0 29
	depends on GPIO_AUDIO_AMP_POWER
	default 7

config GPIO_AUDIO_AMP_POWER_LOW_ACTIVE
	bool "Low Active"
	depends on GPIO_AUDIO_AMP_POWER
	default y

config PANTHER_SND_PCM0
	bool "PCM module 0"
	depends on PANTHER_SND
	default y

choice
	prompt "PCM0 Codec select"
	depends on PANTHER_SND_PCM0
	default PANTHER_SND_WM8750

config PANTHER_SND_PCM0_TLV320AIC3111
	bool "Texas Instruments TLV320AIC31xx CODECs"
	select I2C
	select MONTAGE_I2C

config PANTHER_SND_PCM0_WM8750
	bool "Wolfson WM8750"
	select I2C
	select MONTAGE_I2C

config PANTHER_SND_PCM0_WM8988
	bool "Wolfson WM8988"
	select I2C
	select MONTAGE_I2C

config PANTHER_SND_PCM0_NAU8822
	bool "Nuvoton NAU8822"
	select I2C
	select MONTAGE_I2C

config PANTHER_SND_PCM0_TAS5711
	bool "Texas TAS5711"
	select I2C
	select MONTAGE_I2C

config PANTHER_SND_PCM0_ES8316
	bool "Everest Semiconductor ES8316"
	select I2C
	select MONTAGE_I2C
	select GPIO_AUDIO_AMP_POWER
	help
	  This codec has to enable AUDIO_AMP_POWER: GPIO9

config PANTHER_SND_PCM0_ES9023
	bool "ES9023"

config PANTHER_SND_PCM0_MP320
	bool "Maples MP320"
	select I2C
	select MONTAGE_I2C

config PANTHER_SND_PCM0_WM8737
	bool "Wolfson WM8737"
	select I2C
	select MONTAGE_I2C

endchoice

choice
	prompt "Select WM8xxx Input Source"
	depends on PANTHER_SND_PCM0
	depends on PANTHER_SND_PCM0_WM8750 || PANTHER_SND_PCM0_WM8988 || PANTHER_SND_PCM0_WM8737
	default PANTHER_SND_PCM0_WM8xxx_INPUT2

config PANTHER_SND_PCM0_WM8xxx_INPUT1
	bool "Input1"

config PANTHER_SND_PCM0_WM8xxx_INPUT2
	bool "Input2"

config PANTHER_SND_PCM0_WM8xxx_INPUT3
	bool "Input3"
endchoice

choice
	prompt "Select MP320 Input Source"
	depends on PANTHER_SND_PCM0
	depends on PANTHER_SND_PCM0_MP320
	default PANTHER_SND_PCM0_MP320_INPUT2

config PANTHER_SND_PCM0_MP320_INPUT1
	bool "Input1"

config PANTHER_SND_PCM0_MP320_INPUT2
	bool "Input2"

config PANTHER_SND_PCM0_MP320_INPUT3
	bool "Input3"
endchoice

config PANTHER_SND_PCM1
	bool "PCM module 1"
	depends on PANTHER_SND
	default n

choice
	prompt "PCM1 Codec select"
	depends on PANTHER_SND_PCM1
	default PANTHER_SND_WM8750

config PANTHER_SND_PCM1_WM8750
	bool "Wolfson WM8750"
	select I2C
	select MONTAGE_I2C

config PANTHER_SND_PCM1_WM8988
	bool "Wolfson WM8988"
	select I2C
	select MONTAGE_I2C

config PANTHER_SND_PCM1_NAU8822
	bool "Nuvoton NAU8822"
	select I2C
	select MONTAGE_I2C

config PANTHER_SND_PCM1_TAS5711
	bool "Texas TAS5711"
	select I2C
	select MONTAGE_I2C

config PANTHER_SND_PCM1_MP320
	bool "Maples MP320"
	select I2C
	select MONTAGE_I2C

config PANTHER_SND_PCM1_WM8737
	bool "Wolfson WM8737"
	select I2C
	select MONTAGE_I2C

endchoice

choice
	prompt "Select WM8xxx Input Source"
	depends on PANTHER_SND_PCM1
	depends on PANTHER_SND_PCM1_WM8750 || PANTHER_SND_PCM1_WM8988 || PANTHER_SND_PCM1_WM8737
	default PANTHER_SND_PCM1_WM8xxx_INPUT2

config PANTHER_SND_PCM1_WM8xxx_INPUT1
	bool "Input1"

config PANTHER_SND_PCM1_WM8xxx_INPUT2
	bool "Input2"

config PANTHER_SND_PCM1_WM8xxx_INPUT3
	bool "Input3"
endchoice

choice
	prompt "Select MP320 Input Source"
	depends on PANTHER_SND_PCM1
	depends on PANTHER_SND_PCM1_MP320
	default PANTHER_SND_PCM1_MP320_INPUT2

config PANTHER_SND_PCM1_MP320_INPUT1
	bool "Input1"

config PANTHER_SND_PCM1_MP320_INPUT2
	bool "Input2"

config PANTHER_SND_PCM1_MP320_INPUT3
	bool "Input3"
endchoice

config PANTHER_USB
	bool

choice
	bool "Panther USB0 driver"
	depends on PANTHER
	default PANTHER_USB_NONE

config PANTHER_USB_NONE
	bool "None"

config PANTHER_USB_HOST_ROLE
	bool "As USB Host"
	select USB_SUPPORT
	select USB
	select USB_EHCI_HCD
	select USB_EHCI_MT
	select PANTHER_USB

config PANTHER_USB_DEVICE_ROLE
	bool "As USB Device"
	select USB_SUPPORT
	select USB_GADGET
	select PANTHER_USB

config PANTHER_USB_DUAL_ROLE
	bool "Dual role by VBus Detection"
	select USB_SUPPORT
	select USB
	select USB_EHCI_HCD
	select USB_EHCI_MT
	select USB_GADGET
	select PANTHER_USB
endchoice

choice
	bool "Panther USB1 driver"
	depends on PANTHER
	default PANTHER_USB1_NONE

config PANTHER_USB1_NONE
	bool "None"

config PANTHER_USB1_HOST_ROLE
	bool "As USB Host"
	select USB_SUPPORT
	select USB
	select USB_EHCI_HCD
	select USB_EHCI_MT
	select PANTHER_USB

config PANTHER_USB1_DEVICE_ROLE
	bool "As USB Device"
	select USB_SUPPORT
	select USB_GADGET
	select PANTHER_USB
endchoice

config PANTHER_SDHCI
	tristate "Panther SDHCI driver"
	depends on PANTHER
	select MMC
	select MMC_SDHCI_IO_ACCESSORS
	default n

config PANTHER_SDHCI_VOLTAGE_CTRL
	bool "SDHCI 3.3 or 1.8 voltage control by software"
	depends on PANTHER_SDHCI
	default n

config PANTHER_MMCSPI
	tristate "Panther MMC SPI driver"
	depends on PANTHER
	select SPI_MASTER
#	select MMC_SPI
#	help: using PANTHER_MMCSPI to replace MMC_SPI
	select CRC7
	select CRC_ITU_T
	select SPI_GPIO
	default n

config PANTHER_SPI_SCK_GPIO_NUM
	int "GPIO Number for SPI SCK (0~29)"
	range 0 29
	depends on PANTHER_MMCSPI
	default 3

config PANTHER_SPI_MOSI_GPIO_NUM
	int "GPIO Number for SPI MOSI (0~29)"
	range 0 29
	depends on PANTHER_MMCSPI
	default 2

config PANTHER_SPI_MISO_GPIO_NUM
	int "GPIO Number for SPI MISO (0~29)"
	range 0 29
	depends on PANTHER_MMCSPI
	default 24

config PANTHER_SPI_CS_GPIO_NUM
	int "GPIO Number for SPI CS (0~29)"
	range 0 29
	depends on PANTHER_MMCSPI
	default 27

config PANTHER_SPI_CD_GPIO_NUM
	int "GPIO Number for SPI CD (0~29)"
	range 0 29
	depends on PANTHER_MMCSPI
	default 5

config PANTHER_SPI_IRQ_GPIO_NUM
	int "GPIO Number for SPI IRQ (0~29)"
	range 0 29
	depends on PANTHER_MMCSPI
	default 25

config PANTHER_GSPI
	bool "Panther GSPI driver"
	depends on PANTHER
	select SPI
	default n

config PANTHER_BOOTLOADER_CDB
	bool "Support reading bootloader parameters via PROCFS"
	depends on PROC_FS && PANTHER
	default n

config FLASH_BASE
	hex "FlashROM base address"
	depends on PANTHER_BOOTLOADER_CDB
	default 0xbe000000

config BOOT_PARM_OFS
	hex "Boot parameters offset"
	depends on PANTHER_BOOTLOADER_CDB
	default 0x2000

config BOOT_PARM_SZ
	hex "Boot parameters size"
	depends on PANTHER_BOOTLOADER_CDB
	default 0x4000

config PANTHER_PDMA
	bool "Panther PDMA engine"
	depends on PANTHER
	default y

config PANTHER_GDMA
	bool "Panther GDMA engine"
	depends on PANTHER
	default y

config PANTHER_GVCOM
	bool "Panther GPIO Virtual COM"
	depends on PANTHER
	default n

config PANTHER_GVCOM_TX_GPIO_NUM
	int "GPIO Number for Virtaul COM TX (0~29)"
	range 0 29
	depends on PANTHER_GVCOM
	default 14

config PANTHER_GVCOM_RX_GPIO_NUM
	int "GPIO Number for Virtaul COM RX (0~29)"
	range 0 29
	depends on PANTHER_GVCOM
	default 15

choice
	prompt "Select Default Baud Rate"
	depends on PANTHER_GVCOM && !PANTHER_GVCOM_CONSOLE
	default PANTHER_GVCOM_B38400
config PANTHER_GVCOM_B9600
	bool "9600"
config PANTHER_GVCOM_B14400
	bool "14400"
config PANTHER_GVCOM_B19200
	bool "19200"
config PANTHER_GVCOM_B38400
	bool "38400"
config PANTHER_GVCOM_B57600
	bool "57600"
config PANTHER_GVCOM_B115200
	bool "115200"
endchoice

config PANTHER_GVCOM_CONSOLE
	bool "Virtual COM is Console (Baud Rate:9600)"
	depends on PANTHER_GVCOM
	default n

config PANTHER_GVCOM_DUMMY
	bool "Virtual COM is Dummy"
	depends on PANTHER_GVCOM
	default n

config PANTHER_GI2C
	bool "Panther GPIO I2C"
	depends on PANTHER
	select I2C
	select I2C_GPIO
	select I2C_CHARDEV

config PANTHER_GI2C_SCL_GPIO_NUM
	int "GPIO Number for I2C Clock (0~29)"
	range 0 29
	depends on PANTHER_GI2C
	default 14
config PANTHER_GI2C_SDA_GPIO_NUM
	int "GPIO Number for I2C Data (0~29)"
	range 0 29
	depends on PANTHER_GI2C
	default 15

config PANTHER_LEDGPIO
	bool "Panther LED GPIO"
	depends on PANTHER
	select NEW_LEDS
	select LEDS_CLASS
	select GENERIC_GPIO
	select LEDS_GPIO
	default n
config PANTHER_LEDGPIO_00
	bool "Panther LED GPIO00"
	depends on PANTHER_LEDGPIO
	default n
config PANTHER_LEDGPIO_01
	bool "Panther LED GPIO01"
	depends on PANTHER_LEDGPIO
	default n
config PANTHER_LEDGPIO_02
	bool "Panther LED GPIO02"
	depends on PANTHER_LEDGPIO
	default n
config PANTHER_LEDGPIO_03
	bool "Panther LED GPIO03"
	depends on PANTHER_LEDGPIO
	default n
config PANTHER_LEDGPIO_04
	bool "Panther LED GPIO04"
	depends on PANTHER_LEDGPIO
	default n
config PANTHER_LEDGPIO_05
	bool "Panther LED GPIO05"
	depends on PANTHER_LEDGPIO
	default n
config PANTHER_LEDGPIO_06
	bool "Panther LED GPIO06"
	depends on PANTHER_LEDGPIO
	default n
config PANTHER_LEDGPIO_07
	bool "Panther LED GPIO07"
	depends on PANTHER_LEDGPIO
	default n
config PANTHER_LEDGPIO_08
	bool "Panther LED GPIO08"
	depends on PANTHER_LEDGPIO
	default n
config PANTHER_LEDGPIO_09
	bool "Panther LED GPIO09"
	depends on PANTHER_LEDGPIO
	default n
config PANTHER_LEDGPIO_10
	bool "Panther LED GPIO10"
	depends on PANTHER_LEDGPIO
	default n
config PANTHER_LEDGPIO_11
	bool "Panther LED GPIO11"
	depends on PANTHER_LEDGPIO
	default n
config PANTHER_LEDGPIO_12
	bool "Panther LED GPIO12"
	depends on PANTHER_LEDGPIO
	default n
config PANTHER_LEDGPIO_13
	bool "Panther LED GPIO13"
	depends on PANTHER_LEDGPIO
	default n
config PANTHER_LEDGPIO_14
	bool "Panther LED GPIO14"
	depends on PANTHER_LEDGPIO
	default n
config PANTHER_LEDGPIO_15
	bool "Panther LED GPIO15"
	depends on PANTHER_LEDGPIO
	default n
config PANTHER_LEDGPIO_16
	bool "Panther LED GPIO16"
	depends on PANTHER_LEDGPIO
	default n
config PANTHER_LEDGPIO_17
	bool "Panther LED GPIO17"
	depends on PANTHER_LEDGPIO
	default n
config PANTHER_LEDGPIO_18
	bool "Panther LED GPIO18"
	depends on PANTHER_LEDGPIO
	default n
config PANTHER_LEDGPIO_19
	bool "Panther LED GPIO19"
	depends on PANTHER_LEDGPIO
	default n
config PANTHER_LEDGPIO_20
	bool "Panther LED GPIO20"
	depends on PANTHER_LEDGPIO
	default n
config PANTHER_LEDGPIO_21
	bool "Panther LED GPIO21"
	depends on PANTHER_LEDGPIO
	default n
config PANTHER_LEDGPIO_22
	bool "Panther LED GPIO22"
	depends on PANTHER_LEDGPIO
	default n
config PANTHER_LEDGPIO_23
	bool "Panther LED GPIO23"
	depends on PANTHER_LEDGPIO
	default n
config PANTHER_LEDGPIO_24
	bool "Panther LED GPIO24"
	depends on PANTHER_LEDGPIO
	default n
config PANTHER_LEDGPIO_25
	bool "Panther LED GPIO25"
	depends on PANTHER_LEDGPIO
	default n
config PANTHER_LEDGPIO_26
	bool "Panther LED GPIO26"
	depends on PANTHER_LEDGPIO
	default n
config PANTHER_LEDGPIO_27
	bool "Panther LED GPIO27"
	depends on PANTHER_LEDGPIO
	default n
config PANTHER_LEDGPIO_28
	bool "Panther LED GPIO28"
	depends on PANTHER_LEDGPIO
	default n
config PANTHER_LEDGPIO_29
	bool "Panther LED GPIO29"
	depends on PANTHER_LEDGPIO
	default n
config PANTHER_LEDGPIO_30
	bool "Panther LED GPIO30"
	depends on PANTHER_LEDGPIO
	default n
config PANTHER_LEDGPIO_31
	bool "Panther LED GPIO31"
	depends on PANTHER_LEDGPIO
	default n
config PANTHER_LEDGPIO_32
	bool "Panther LED GPIO32"
	depends on PANTHER_LEDGPIO
	default n
config PANTHER_LEDGPIO_33
	bool "Panther LED GPIO33"
	depends on PANTHER_LEDGPIO
	default n

config LEDS_TRIGGER_CTAINTF
	bool "LED Network Interface Trigger for Panther"
	select NEW_LEDS
	select LEDS_TRIGGERS
	default n

config PANTHER_GPIO_ROTARY_ENCODER
	bool "Panther GPIO Rotary encoders"
	select INPUT
	select GPIOLIB
	select GENERIC_GPIO
	depends on PANTHER && !PANTHER_GVCOM
	default n
	help
	  Say Y here to add support for rotary encoders connected to GPIO lines.

config PANTHER_ROTARY_ENCODER_GPIO_A
	int "GPIO Number for Rotary Encoder pin A (0~29)"
	range 0 29
	depends on PANTHER_GPIO_ROTARY_ENCODER
	default 13
config PANTHER_ROTARY_ENCODER_GPIO_B
	int "GPIO Number for Rotary Encoder pin B (0~29)"
	range 0 29
	depends on PANTHER_GPIO_ROTARY_ENCODER
	default 19

config PANTHER_UART_BAUDRATE
	int "UART Baud Rate"
	depends on PANTHER
	default 115200

config MONTAGE_I2C
        bool "I2C hardware bus support"
        depends on I2C
        default y

config MONTAGE_WATCHDOG
        bool "Watchdog Timer support"
        depends on WATCHDOG
        default y
        help
          Hardware driver for the built-in watchdog timer.
```
